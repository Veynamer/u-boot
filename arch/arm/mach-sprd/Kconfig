## arch/arm/mach-sprd/Kconfig
```kconfig
if ARCH_SPRD

config TEXT_BASE
	default 0x9f000000

config SYS_LOAD_ADDR
	default 0x90000000

choice
	prompt "Unisoc target SoC"

config TARGET_UMS512
	bool "UMS512 (T610/T618/T700)"
	select ARM64

endchoice

config SYS_SOC
	default "sprd"

config SYS_VENDOR
	string "Board vendor"
	default "unisoc"

config SYS_BOARD
	string "Board name"
	default "ums512" if TARGET_UMS512

config SYS_CONFIG_NAME
	string "Board configuration name"
	default "ums512" if TARGET_UMS512

endif
```
